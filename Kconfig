## Kconfig
```kconfig
menu "FreeModbus"
    config MCUX_COMPONENT_middleware.freemodbus.rtu
        bool "rtu"
        
    if MCUX_COMPONENT_middleware.freemodbus.rtu
        choice
            prompt "rtu anyOf 1"
            default MCUX_DEPENDENCY_COMPONENT_middleware.freemodbus.rtu_DEPEND_ANYOF_1_OPTION_1
            config MCUX_DEPENDENCY_COMPONENT_middleware.freemodbus.rtu_DEPEND_ANYOF_1_OPTION_1
                bool "Select MCUX_COMPONENT_middleware.baremetal"
        endchoice
    endif

    config MCUX_COMPONENT_middleware.freemodbus.rtuc
        bool "rtuc"
        
    if MCUX_COMPONENT_middleware.freemodbus.rtuc
        choice
            prompt "rtuc anyOf 1"
            default MCUX_DEPENDENCY_COMPONENT_middleware.freemodbus.rtuc_DEPEND_ANYOF_1_OPTION_1
            config MCUX_DEPENDENCY_COMPONENT_middleware.freemodbus.rtuc_DEPEND_ANYOF_1_OPTION_1
                bool "Select MCUX_COMPONENT_middleware.baremetal"
        endchoice
    endif

    config MCUX_COMPONENT_middleware.freemodbus.tcp
        bool "tcp"
        
    if MCUX_COMPONENT_middleware.freemodbus.tcp
        choice
            prompt "tcp anyOf 1"
            default MCUX_DEPENDENCY_COMPONENT_middleware.freemodbus.tcp_DEPEND_ANYOF_1_OPTION_1
            config MCUX_DEPENDENCY_COMPONENT_middleware.freemodbus.tcp_DEPEND_ANYOF_1_OPTION_1
                bool "Select MCUX_COMPONENT_middleware.freertos-kernel"
                select MCUX_COMPONENT_middleware.freertos-kernel
        endchoice
    endif
endmenu
```
